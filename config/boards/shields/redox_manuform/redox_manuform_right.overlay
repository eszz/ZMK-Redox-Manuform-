#include "redox_manuform.dtsi"

&default_transform {
	row-offset = <7>;
};

&kscan0 {
    col-gpios 
            = <&gpio0 6 (GPIO_ACTIVE_HIGH | GPIO_PULL_DOWN)>,   // 列1
                <&gpio0 8 (GPIO_ACTIVE_HIGH | GPIO_PULL_DOWN)>,   // 列2
                <&gpio0 17 (GPIO_ACTIVE_HIGH | GPIO_PULL_DOWN)>,  // 列3
                <&gpio0 20 (GPIO_ACTIVE_HIGH | GPIO_PULL_DOWN)>,  // 列4
                <&gpio0 22 (GPIO_ACTIVE_HIGH | GPIO_PULL_DOWN)>;  // 列5

    row-gpios 
            = <&gpio0 24 >,  // 行1
                <&gpio1 0 GPIO_ACTIVE_HIGH>,   // 行2
                <&gpio0 11 GPIO_ACTIVE_HIGH>,  // 行3
                <&gpio1 4 GPIO_ACTIVE_HIGH>,   // 行4
                <&gpio1 6 GPIO_ACTIVE_HIGH>,   // 行5
                <&gpio0 9 GPIO_ACTIVE_HIGH>,   // 行6
                <&gpio0 31 GPIO_ACTIVE_HIGH>;  // 行7 
};

