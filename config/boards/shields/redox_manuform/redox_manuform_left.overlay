#include "redox_manuform.dtsi"

&kscan0 {
    diode-direction = "row2col";
    col-gpios 
            = <&gpio0 6 (GPIO_ACTIVE_HIGH | GPIO_PULL_DOWN)>,   // 行1
                <&gpio0 8 (GPIO_ACTIVE_HIGH | GPIO_PULL_DOWN)>,   // 行2
                <&gpio0 17 (GPIO_ACTIVE_HIGH | GPIO_PULL_DOWN)>,  // 行3
                <&gpio0 20 (GPIO_ACTIVE_HIGH | GPIO_PULL_DOWN)>,  // 行4
                <&gpio0 22 (GPIO_ACTIVE_HIGH | GPIO_PULL_DOWN)>,  // 行5
                <&gpio0 24 (GPIO_ACTIVE_HIGH | GPIO_PULL_DOWN)>,  // 行6
                <&gpio1 0 (GPIO_ACTIVE_HIGH | GPIO_PULL_DOWN)>;   // 行7

    row-gpios 
            = <&gpio0 11 GPIO_ACTIVE_HIGH>,  // 列1
                <&gpio1 4 GPIO_ACTIVE_HIGH>,   // 列2                                                                               
                <&gpio1 6 GPIO_ACTIVE_HIGH>,   // 列3
                <&gpio0 9 GPIO_ACTIVE_HIGH>,   // 列4
                <&gpio0 31 GPIO_ACTIVE_HIGH>;  // 列5 
};
