## config/boards/shields/redox_manuform/Kconfig.defconfig
```kconfig
if SHIELD_REDOX_MANUFORM_LEFT

config ZMK_KEYBOARD_NAME
	default "redox_manuform"

config ZMK_SPLIT_ROLE_CENTRAL
	default y

endif

if SHIELD_REDOX_MANUFORM_LEFT || SHIELD_REDOX_MANUFORM_RIGHT

config ZMK_SPLIT
	default y

endif
```

## config/boards/shields/redox_manuform/Kconfig.shield
```kconfig
config SHIELD_REDOX_MANUFORM_LEFT
    def_bool $(shields_list_contains,redox_manuform_left)

config SHIELD_REDOX_MANUFORM_RIGHT
    def_bool $(shields_list_contains,redox_manuform_right)
```
